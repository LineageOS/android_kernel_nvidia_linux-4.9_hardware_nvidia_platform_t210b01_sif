/*This dtsi file was generated by sif-p3425-a01.xlsm Revision: 44 */
/*
 * Copyright (c) 2019, NVIDIA CORPORATION.  All rights reserved.
 *
 * This program is free software; you can redistribute it and/or modify
 * it under the terms of the GNU General Public License as published by
 * the Free Software Foundation; either version 2 of the License, or
 * (at your option) any later version.
 *
 * This program is distributed in the hope that it will be useful, but WITHOUT
 * ANY WARRANTY; without even the implied warranty of MERCHANTABILITY or
 * FITNESS FOR A PARTICULAR PURPOSE.  See the GNU General Public License for
 * more details.
 */

#include <dt-bindings/gpio/tegra-gpio.h>

/ {
	gpio@6000d000 {
		gpio-init-names = "default";
		gpio-init-0 = <&gpio_default>;

		gpio_default: default {
			gpio-input = <
				TEGRA_GPIO(E, 6)
				TEGRA_GPIO(X, 6)
				TEGRA_GPIO(X, 7)
				TEGRA_GPIO(Y, 1)
				TEGRA_GPIO(Z, 0)
				TEGRA_GPIO(G, 0)
				TEGRA_GPIO(H, 2)
				TEGRA_GPIO(H, 5)
				TEGRA_GPIO(CC, 1)
				>;
			gpio-output-low = <
				TEGRA_GPIO(E, 4)
				TEGRA_GPIO(H, 0)
				TEGRA_GPIO(H, 3)
				TEGRA_GPIO(H, 4)
				TEGRA_GPIO(CC, 7)
				>;
			gpio-output-high = <
				>;
		};
	};
};
